## main/Kconfig.projbuild
```kconfig
menu "Application Configuration"

	config ESP_WIFI_SSID
		string "WiFi SSID"
		default "myssid"
		help
			SSID (network name) for to connect to.

	config ESP_WIFI_PASSWORD
		string "WiFi Password"
		default "mypassword"
		help
			WiFi password (WPA or WPA2) to use.

	config ESP_MAXIMUM_RETRY
		int "Maximum retry"
		default 5
		help
			Set the Maximum retry to avoid station reconnecting to the AP unlimited when the AP is really inexistent.

	
	config SSH_USER
		string "SSH Username"
		default "ssh-user"
		help
			Username of SSH Connection.

	config SSH_PASSWORD
		string "SSH Password"
		default "ssh-pass"
		help
			Password of SSH Connection.

	config SSH_HOST
		string "SSH Host"
		default "ssh-host.local"
		help
			IP address or mDNS of SSH host.

	config SSH_PORT
		int "SSH Port"
		default 22
		help
			Port number of SSH server.

endmenu
```

## sdkconfig.defaults
```kconfig
#
# Partition Table
#
CONFIG_PARTITION_TABLE_CUSTOM=y
CONFIG_PARTITION_TABLE_CUSTOM_FILENAME="partitions.csv"
CONFIG_PARTITION_TABLE_FILENAME="partitions.csv"

#
# Symmetric Ciphers
#
CONFIG_MBEDTLS_RC4_ENABLED=y
CONFIG_MBEDTLS_BLOWFISH_C=y
```
